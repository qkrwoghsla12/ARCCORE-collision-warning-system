AUTOSAR XML (schema 4-3-0)
package /ARRoot
  ecuc value collection CollisiondetectionBSWConfiguration: ecu-extract=CollisionDetectionEcuExtract, ecuc-values=[BswM, Can, CanIf, ComM, Com, CanSM, Dio, EcuM, Gpt, Mcu, Port, Rte, PduR, EcuC, IoHwAb, Os, Det]
  module config BswM: implementation-config-variant=VARIANT-PRE-COMPILE, module-description=BswM
    BswMConfig
      BswMArbitration: ArcBswMMaxRuleCount=20
        3 x BswMLogicalExpression:
          ComMFullCommuncationlExpression: BswMArgumentRef=ComMFullCommunicationCondition
          ComMNoCommuncationlExpression: BswMArgumentRef=ComMNoCommunicationCondition
          StartCommunicationExpression: BswMArgumentRef=StartCommunicationCondition
        3 x BswMModeCondition:
          ComMFullCommunicationCondition: BswMConditionType=BSWM_EQUALS, BswMConditionMode=BswComMIndication
            BswMConditionValue
              BswMBswMode: BswMBswRequestedMode=COMM_FULL_COMMUNICATION
          StartCommunicationCondition: BswMConditionType=BSWM_EQUALS_NOT, BswMConditionMode=SwcStartCommunication
            BswMConditionValue
              BswMBswMode: BswMBswRequestedMode=COMM_SILENT_COMMUNICATION
          ComMNoCommunicationCondition: BswMConditionType=BSWM_EQUALS, BswMConditionMode=BswComMIndication
            BswMConditionValue
              BswMBswMode: BswMBswRequestedMode=COMM_NO_COMMUNICATION
        BswComMIndication (BswMModeRequestPort): BswMRequestProcessing=BSWM_DEFERRED
          BswMModeRequestSource
            BswMComMIndication: BswMComMChannelRef=ComMChannel
        SwcStartCommunication (BswMModeRequestPort): BswMRequestProcessing=BSWM_DEFERRED
          BswMModeRequestSource
            BswMSwcModeRequest: BswMSwcModeRequestModeDeclarationGroupPrototypeRef=currentMode
        3 x BswMRule, all with BswMNestedExecutionOnly=false, BswMRuleInitState=BSWM_FALSE:
          DisablePduGroupsRule: BswMRuleExpressionRef=ComMNoCommuncationlExpression, BswMRuleTrueActionList=DisablePdusActions
          StartCommunicationRule: BswMRuleExpressionRef=StartCommunicationExpression, BswMRuleTrueActionList=StartCommuncationActions
          EnablePduGroupsRule: BswMRuleExpressionRef=ComMFullCommuncationlExpression, BswMRuleTrueActionList=EnablePdusActions
      BswMModeControl
        3 x BswMAction:
          IPduAllDisabled
            BswMAvailableActions
              BswMPduGroupSwitch: BswMPduGroupSwitchReinit=true, BswMDisabledPduGroupRef=ComIPduGroupRx, BswMDisabledPduGroupRef=ComIPduGroupTx
          RequestFullCom
            BswMAvailableActions
              BswMComMModeSwitch: BswMComMRequestedMode=BSWM_FULL_COM, BswMComMUserRef=ComMUser
          IPduAllEnabled
            BswMAvailableActions
              BswMPduGroupSwitch: BswMPduGroupSwitchReinit=true, BswMEnabledPduGroupRef=ComIPduGroupRx, BswMEnabledPduGroupRef=ComIPduGroupTx
        3 x BswMActionList, all with BswMActionListExecution=BSWM_TRIGGER:
          DisablePdusActions
            BswMActionListItem: BswMAbortOnFail=false, BswMActionListItemIndex=0, BswMActionListItemRef=IPduAllDisabled
          StartCommuncationActions
            BswMActionListItem: BswMAbortOnFail=false, BswMActionListItemIndex=0, BswMActionListItemRef=RequestFullCom
          EnablePdusActions
            BswMActionListItem: BswMAbortOnFail=false, BswMActionListItemIndex=0, BswMActionListItemRef=IPduAllEnabled
    BswMGeneral: BswMDevErrorDetect=false, BswMVersionInfoApi=true, BswMSdEnabled=false, BswMEcuMEnabled=1, BswMCanSMEnabled=1, BswMComMEnabled=1
  module config Can: implementation-config-variant=VARIANT-PRE-COMPILE, module-description=Can
    CanConfigSet
      CanController0 (CanController):
        CanBusoffProcessing = INTERRUPT
        CanControllerActivation = true
        CanControllerBaseAddress = 
        CanControllerId = 0
        CanRxProcessing = INTERRUPT
        CanTxProcessing = INTERRUPT
        CanWakeupFunctionalityAPI = false
        CanWakeupProcessing = INTERRUPT
        CanWakeupSupport = false
        ArcCanControllerLoopback = false
        ArcCanNumMessageBox = 64
        ArcCanControllerHwUnit = FLEXCAN_A
        ArcCanClockSourceOscillator = true
        CanControllerDefaultBaudrate = CanControllerBaudrateConfig0
        CanCpuClockRef = (unset)
        CanControllerBaudrateConfig0 (CanControllerBaudrateConfig):
          CanControllerBaudRate = 500
          CanControllerBaudRateConfigID = 0
          CanControllerPropSeg = 7
          CanControllerSeg1 = 6
          CanControllerSeg2 = 2
          CanControllerSyncJumpWidth = 1
      Ctrl_0_Rx_0 (CanHardwareObject):
        CanHandleType = BASIC
        CanIdType = STANDARD
        CanObjectId = 
        CanObjectType = RECEIVE
        ArcCanFifoEnable = false
        ArcCanMessageboxesPerHwObj = 
        CanHwObjectCount = 1
        CanControllerRef = CanController0
        CanHwFilter: CanHwFilterCode=0, CanHwFilterMask=0
      Ctrl_0_Tx_0 (CanHardwareObject):
        CanHandleType = BASIC
        CanIdType = STANDARD
        CanObjectId = 
        CanObjectType = TRANSMIT
        ArcCanFifoEnable = false
        ArcCanMessageboxesPerHwObj = 
        CanHwObjectCount = 1
        CanControllerRef = CanController0
    CanGeneral:
      CanDevErrorDetection = true
      CanHardwareCancellation = false
      CanIdenticalIdCancellation = false
      CanIndex = 
      CanMainFunctionModePeriod = 
      CanMultiplexedTransmission = false
      CanTimeoutDuration = 
      CanVersionInfoApi = false
      CanCounterRef = (unset)
      CanSupportTTCANRef = (unset)
      CanMainFunctionRWPeriods
  module config CanIf: implementation-config-variant=VARIANT-PRE-COMPILE, module-description=CanIf
    CanIfCtrlDrvCfg: CanIfCtrlDrvTxCancellation=false, CanIfCtrlDrvInitHohConfigRef=CanIfInitHohCfg, CanIfCtrlDrvNameRef=(unset)
      CanIfCtrlCfg: CanIfCtrlId=, CanIfCtrlWakeupSupport=false, CanIfCtrlCanCtrlRef=CanController0
    CanIfDispatchCfg:
      CanIfDispatchUserConfirmPnAvailabilityName = 
      CanIfDispatchUserConfirmPnAvailabilityUL = 
      CanIfDispatchUserCtrlBusOffUL = CAN_SM
      CanIfDispatchUserCtrlModeIndicationUL = CAN_SM
    CanIfInitCfg: CanIfInitCfgSet=
      CanIfBufferCfg: CanIfBufferSize=0, CanIfBufferHthRef=CanIfHthCfg
      CanIfInitHohCfg: CanIfInitRefCfgSet=(unset)
        CanIfHrhCfg: CanIfHrhSoftwareFilter=true, CanIfHrhCanCtrlIdRef=CanIfCtrlCfg, CanIfHrhIdSymRef=Ctrl_0_Rx_0
        CanIfHthCfg: CanIfHthCanCtrlIdRef=CanIfCtrlCfg, CanIfHthIdSymRef=Ctrl_0_Tx_0
      CanIfRxPduCfg:
        CanIfRxPduCanIdType = STANDARD_CAN
        CanIfRxPduDlc = 4
        CanIfRxPduId = 
        CanIfRxPduReadData = false
        CanIfRxPduReadNotifyStatus = false
        CanIfRxPduCanId = 1
        CanIfRxPduUserRxIndicationUL = PDUR
        CanIfRxPduBswSchExclAreaIdRef = (unset)
        CanIfRxPduRef = PduRx
        CanIfRxPduHrhIdRef = CanIfHrhCfg
      CanIfTxPduCfg:
        CanIfTxPduCanId = 1
        CanIfTxPduCanIdType = STANDARD_CAN
        CanIfTxPduDlc = 4
        CanIfTxPduId = 
        CanIfTxPduReadNotifyStatus = false
        CanIfTxPduType = STATIC
        CanIfTxPduUserTxConfirmationUL = PDUR
        CanIfTxPduBswSchExclAreaIdRef = (unset)
        CanIfTxPduBufferRef = CanIfBufferCfg
        CanIfTxPduRef = PduTx
      CanIfRxPduCfg2 (CanIfRxPduCfg):
        CanIfRxPduCanIdType = STANDARD_CAN
        CanIfRxPduDlc = 4
        CanIfRxPduId = 
        CanIfRxPduReadData = false
        CanIfRxPduReadNotifyStatus = false
        CanIfRxPduCanId = 2
        CanIfRxPduUserRxIndicationUL = PDUR
        CanIfRxPduBswSchExclAreaIdRef = (unset)
        CanIfRxPduHrhIdRef = CanIfHrhCfg
        CanIfRxPduRef = PduRx
    CanIfPrivateCfg: CanIfPrivateDlcCheck=true, CanIfPrivateSoftwareFilterType=LINEAR, CanIfSupportTTCAN=false
    CanIfPublicCfg:
      CanIfPublicCancelTransmitSupport = false
      CanIfPublicChangeBaudrateSupport = false
      CanIfPublicDevErrorDetect = true
      CanIfPublicHandleTypeEnum = 
      CanIfPublicMultipleDrvSupport = true
      CanIfPublicNumberOfCanHwUnits = 1
      CanIfPublicPnSupport = false
      CanIfPublicReadRxPduDataApi = false
      CanIfPublicReadRxPduNotifyStatusApi = false
      CanIfPublicReadTxPduNotifyStatusApi = false
      CanIfPublicSetDynamicTxIdApi = false
      CanIfPublicTxBuffering = false
      CanIfPublicTxConfirmPollingSupport = false
      CanIfPublicVersionInfoApi = false
      CanIfPublicWakeupCheckValidSupport = false
      ArcCanIfPublicTxBufferSize = 1
      ArcCanIfPublicMaxNumberOfTxBuffers = 1
      ArcCanIfOsekNmSupport = false
      ArcCanIfCanFDSupport = false
  module config ComM: implementation-config-variant=VARIANT-PRE-COMPILE, module-description=ComM
    ComMConfigSet
      ComMChannel:
        ComMBusType = COMM_BUS_TYPE_CAN
        ComMChannelId = 
        ComMFullCommRequestNotificationEnabled = false
        ComMGlobalNvmBlockDescriptor = false
        ComMMainFunctionPeriod = 0.01
        ComMNoCom = false
        ComMNoWakeup = false
        ComMNetworkManagement: ComMNmVariant=NONE, ComMPncNmRequest=false
        ComMUserPerChannel: ComMUserChannel=ComMUser
      ComMUser: ComMUserIdentifier=
    ComMGeneral:
      ComMNoCom = false
      ComMEcuGroupClassification = 3
      ComMModeLimitationEnabled = false
      ComMPncSupport = false
      ComMSynchronousWakeUp = true
      ComMTMinFullComModeDuration = 5.0
      ComMVersionInfoApi = false
      ComMWakeupInhibitionEnabled = false
      ComMDevErrorDetect = true
      ArcComMASRCompatibilityLessThan4_2 = true
  module config Com: implementation-config-variant=VARIANT-PRE-COMPILE, module-description=Com
    ComConfig: ComConfigurationId=
      ComTimeBase: ComTxTimeBase=0.01, ComRxTimeBase=0.01
      CanRxIPdu (ComIPdu):
        ComIPduDirection = RECEIVE
        ComIPduSignalProcessing = DEFERRED
        ComIPduTriggerTransmitCallout = NULL
        ComIPduType = 
        ComPduIdRef = PduRx
        ComIPduGroupRef = ComIPduGroupRx
        ComIPduSignalRef = CanRxSignal
      ComIPduGroupRx (ComIPduGroup): ComIPduGroupHandleId=
      CanTxIPdu (ComIPdu):
        ComIPduDirection = SEND
        ComIPduSignalProcessing = IMMEDIATE
        ComIPduTriggerTransmitCallout = NULL
        ComIPduType = 
        ComPduIdRef = PduTx
        ComIPduGroupRef = ComIPduGroupTx
        ComIPduSignalRef = CanTxSignal
        ComTxIPdu: ComTxIPduUnusedAreasDefault=0
          ComTxModeTrue
            ComTxMode: ComTxModeMode=PERIODIC, ComTxModeTimePeriod=0.04
      ComIPduGroupTx (ComIPduGroup): ComIPduGroupHandleId=
      CanRxSignal (ComSignal):
        ComBitPosition = 0
        ComHandleId = 
        ComSignalEndianness = LITTLE_ENDIAN
        ComSignalType = UINT32
        ComTransferProperty = TRIGGERED_ON_CHANGE
        ComBitSize = 32
        ComSystemTemplateSystemSignalRef = RxMessageMapping
      CanTxSignal (ComSignal):
        ComBitPosition = 0
        ComHandleId = 
        ComSignalEndianness = LITTLE_ENDIAN
        ComSignalType = UINT32
        ComBitSize = 32
        ComSystemTemplateSystemSignalRef = TxMessageMapping
    ComGeneral:
      ComSupportedIPduGroups = 2
      ComVersionInfoApi = false
      ComSupportedIPdus = 20
      ComSupportedSignals = 40
      ComSupportedGroupSignals = 0
      ComRamBufferSize = 1024
      ArcMaxNumberOfSupportedIPduCounters = 0
      ArcComSupportedGatewaySourceDescriptions = 0
      ArcComOsekNmSupport = false
  module config CanSM: implementation-config-variant=VARIANT-PRE-COMPILE, module-description=CanSM
    CanSMConfiguration: CanSMModeRequestRepetitionMax=254, CanSMModeRequestRepetitionTime=0.2
      CanSMManagerNetwork:
        CanSMBorCounterL1ToL2 = 10
        CanSMBorTimeL1 = 0.1
        CanSMBorTimeL2 = 0.1
        CanSMBorTimeTxEnsured = 0.2
        CanSMBorTxConfirmationPolling = false
        CanSMComMNetworkHandleRef = ComMChannel
        CanSMController: CanSMControllerId=CanIfCtrlCfg
    CanSMGeneral: CanSMDevErrorDetect=true, CanSMMainFunctionTimePeriod=0.01, CanSMVersionInfoApi=false, CanSmChangeBaudrateApi=false
  module config Dio: implementation-config-variant=VARIANT-PRE-COMPILE, module-description=Dio
    DioConfig
      LED (DioPort): DioPortId=6
        FrontLED (DioChannel): DioChannelId=98
        RearLED (DioChannel): DioChannelId=99
      UltraSonic (DioPort): DioPortId=10
        SonarEcho (DioChannel): DioChannelId=174
        SonarTrig (DioChannel): DioChannelId=175
    DioGeneral: DioDevErrorDetect=false, DioFlipChannelApi=, DioVersionInfoApi=false
  module config EcuM: implementation-config-variant=VARIANT-PRE-COMPILE, module-description=EcuM
    EcuMConfiguration
      EcuMCommonConfiguration: EcuMConfigConsistencyHash=, EcuMDefaultAppMode=(unset), EcuMOSResource=(unset)
        EcuMDefaultShutdownTarget: EcuMDefaultState=EcuMStateOff
        EcuMSleepMode: EcuMSleepModeId=, EcuMSleepModeSuspend=, EcuMSleepModeMcuModeRef=SLEEP, EcuMWakeupSourceMask=EcuMWakeupSource
        EcuMWakeupSource: EcuMWakeupSourceId=, EcuMWakeupSourcePolling=false, EcuMResetReasonRef=(unset)
      EcuMFixedConfiguration:
        EcuMNvramReadallTimeout = 10.0
        EcuMNvramWriteallTimeout = 10.0
        EcuMRunMinimumDuration = 10.0
        EcuMNormalMcuModeRef = NORMAL
        EcuMComMCommunicationAllowedList = ComMChannel
        EcuMFixedUserConfig: EcuMFixedUser=
    EcuMGeneral: EcuMDevErrorDetect=false, EcuMIncludeDem=false, EcuMIncludeDet=false, EcuMMainFunctionPeriod=0.2, EcuMVersionInfoApi=false
    EcuMFixedGeneral: EcuMIncludeComM=, EcuMIncludeNvM=, EcuMIncludeNvramMgr=, EcuMTTIIEnabled=, EcuMTTIIWakeupSourceRef=(unset)
  module config Gpt: implementation-config-variant=VARIANT-PRE-COMPILE, module-description=Gpt
    GptChannelConfigSet
      GptChannelConfiguration:
        GptChannelId = 
        GptChannelTickFrequency = 
        GptChannelTickValueMax = 
        GptEnableWakeup = false
        ArcCoreGptPhysicalChannel = GPT_CHANNEL_PIT_1
        GptChannelMode = GPT_CH_MODE_CONTINUOUS
        GptChannelClkSrcRef = (unset)
      GptChannelConfiguration2 (GptChannelConfiguration):
        GptChannelId = 
        GptChannelTickFrequency = 
        GptChannelTickValueMax = 
        GptEnableWakeup = false
        ArcCoreGptPhysicalChannel = GPT_CHANNEL_PIT_2
        GptChannelMode = GPT_CH_MODE_CONTINUOUS
        GptChannelClkSrcRef = (unset)
    GptConfigurationOfOptApiServices:
      GptDeinitApi = true
      GptEnableDisableNotificationApi = true
      GptTimeElapsedApi = true
      GptTimeRemainingApi = false
      GptVersionInfoApi = false
      GptWakeupFunctionalityApi = true
    GptDriverConfiguration: GptDevErrorDetect=true, GptReportWakeupSource=false, GptPredefTimer100us32bitEnable=, GptPredefTimer1usEnablingGrade=
      GptClockReferencePoint: GptClockReference=(unset)
  module config Mcu: implementation-config-variant=VARIANT-PRE-COMPILE, module-description=Mcu
    McuGeneralConfiguration: McuDevErrorDetect=true, McuGetRamStateApi=false, McuInitClock=true, McuNoPll=false, McuPerformResetApi=false, McuVersionInfoApi=false
    McuModuleConfiguration: McuClockSrcFailureNotification=DISABLED, McuNumberOfMcuModes=, McuRamSectors=, ArcDefaultClockRef=McuClockSettingConfig
      McuClockSettingConfig: McuClockSettingId=
        McuClockReferencePoint: Frequency=, McuClockReferencePointFrequency=40000000.0
        ArcPLLSettings: PLLDV_PREDIV=1, PLLDV_MFD=16, PLLDV_RFDPHI=1, PLLDV_RFDPHI1=2, PLLFM_MODPRD=0, PLLFM_INCSTP=0, PLLFM_MODEN=false
      3 x McuModeSettingConf, all with McuMode=:
        NORMAL
        RUN
        SLEEP
    McuPublishedInformation
      McuResetReasonConf: McuResetReason=
  module config Port: implementation-config-variant=VARIANT-PRE-COMPILE, module-description=Port
    PortConfigSet
      3 x PortContainer, all with PortNumberOfPortPins=:
        CAN
          CAN0RX (PortPin):
            PortPinDirection = PORT_PIN_IN
            PortPinDirectionChangeable = 0
            PortPinId = 17
            PortPinInitialMode = PORT_PIN_MODE_CAN
            PortPinLevelValue = PORT_PIN_LEVEL_LOW
            PortPinMode = 
            PortPinModeChangeable = 0
            ArcPortPinPull = PORT_PIN_PULL_NONE
            ArcPortPinSlewRate = PORT_PIN_SLEW_RATE_MED
            ArcPortPinOpenDrainEnable = false
          CAN0TX (PortPin):
            PortPinDirection = PORT_PIN_OUT
            PortPinDirectionChangeable = 0
            PortPinId = 16
            PortPinInitialMode = PORT_PIN_MODE_CAN
            PortPinLevelValue = PORT_PIN_LEVEL_LOW
            PortPinMode = 
            PortPinModeChangeable = 0
            ArcPortPinPull = PORT_PIN_PULL_NONE
            ArcPortPinSlewRate = PORT_PIN_SLEW_RATE_MED
            ArcPortPinOpenDrainEnable = false
        LED
          FrontLED (PortPin):
            PortPinDirection = PORT_PIN_OUT
            PortPinDirectionChangeable = 0
            PortPinId = 98
            PortPinInitialMode = PORT_PIN_MODE_DIO
            PortPinLevelValue = PORT_PIN_LEVEL_LOW
            PortPinMode = 
            PortPinModeChangeable = 0
            ArcPortPinPull = PORT_PIN_PULL_NONE
            ArcPortPinSlewRate = PORT_PIN_SLEW_RATE_MED
            ArcPortPinOpenDrainEnable = false
          RearLED (PortPin):
            PortPinDirection = PORT_PIN_OUT
            PortPinDirectionChangeable = 0
            PortPinId = 99
            PortPinInitialMode = PORT_PIN_MODE_DIO
            PortPinLevelValue = PORT_PIN_LEVEL_LOW
            PortPinMode = 
            PortPinModeChangeable = 0
            ArcPortPinPull = PORT_PIN_PULL_NONE
            ArcPortPinSlewRate = PORT_PIN_SLEW_RATE_MED
            ArcPortPinOpenDrainEnable = false
        Sonar
          Sonar_Echo (PortPin):
            PortPinDirection = PORT_PIN_IN
            PortPinDirectionChangeable = 0
            PortPinId = 174
            PortPinInitialMode = PORT_PIN_MODE_DIO
            PortPinLevelValue = PORT_PIN_LEVEL_LOW
            PortPinMode = 
            PortPinModeChangeable = 0
            ArcPortPinPull = PORT_PIN_PULL_DOWN
            ArcPortPinSlewRate = PORT_PIN_SLEW_RATE_MED
            ArcPortPinOpenDrainEnable = false
          Sonar_Trig (PortPin):
            PortPinDirection = PORT_PIN_OUT
            PortPinDirectionChangeable = 0
            PortPinId = 175
            PortPinInitialMode = PORT_PIN_MODE_DIO
            PortPinLevelValue = PORT_PIN_LEVEL_LOW
            PortPinMode = 
            PortPinModeChangeable = 0
            ArcPortPinPull = PORT_PIN_PULL_NONE
            ArcPortPinSlewRate = PORT_PIN_SLEW_RATE_MED
            ArcPortPinOpenDrainEnable = false
    PortGeneral: PortDevErrorDetect=true, PortSetPinDirectionApi=false, PortSetPinModeApi=false, PortVersionInfoApi=false
  module config Rte: implementation-config-variant=VARIANT-PRE-COMPILE, module-description=Rte
    RteBswGeneral: RteSchMVersionInfoApi=, RteUseComShadowSignalApi=false
    RteGeneration:
      RteCalibrationSupport = NONE
      RteCodeVendorId = 
      RteDevErrorDetect = false
      RteDevErrorDetectUninit = false
      RteGenerationMode = COMPATIBILITY_MODE
      RteIocInteractionReturnValue = RTE_IOC
      RteMeasurementSupport = false
      RteOptimizationMode = RUNTIME
      RteValueRangeCheckEnabled = false
      RteVfbTraceEnabled = false
    RteInitializationBehavior: RteInitializationStrategy=, RteSectionInitializationPolicy=
    RteOsInteraction
    RtePostBuildVariantConfiguration: RtePostBuildUsedPredefinedVariant=(unset)
    10 x RteSwComponentInstance:
      bswM: RteSoftwareComponentInstanceRef=bswM
      cantranslateSWC: RteSoftwareComponentInstanceRef=cantranslateSWC
        CanTranslate_timingEvent_0_1_OsSonarTask (RteEventToTaskMapping): RteImmediateRestart=false, RteEventRef=CanTranslate_timingEvent_0_1, RteMappedToTaskRef=OsSonarTask, RteUsedOsEventRef=OsSonarEvent
      collisiondetectionSWC: RteSoftwareComponentInstanceRef=collisiondetectionSWC
        CollisionDetection_timingEvent_0_1_OsCollisionDetectionTask (RteEventToTaskMapping):
          RteImmediateRestart = false
          RteEventRef = CollisionDetection_timingEvent_0_1
          RteMappedToTaskRef = OsCollisionDetectionTask
          RteUsedOsEventRef = OsCollisionDetectionEvent
      comM: RteSoftwareComponentInstanceRef=comM
      ecuM: RteSoftwareComponentInstanceRef=ecuM
      FrontLedSWC: RteSoftwareComponentInstanceRef=FrontLedSWC
        LEDActuator_timingEvent_0_1_OsLEDTask (RteEventToTaskMapping): RteImmediateRestart=false, RteEventRef=LEDActuator_timingEvent_0_1, RteMappedToTaskRef=OsLEDTask, RteUsedOsEventRef=OsLEDEvent
      ioHwAb: RteSoftwareComponentInstanceRef=ioHwAb
      modeManagerInitSWC: RteSoftwareComponentInstanceRef=modeManagerInitSWC
        InitEvent_OsSonarTask (RteEventToTaskMapping): RteImmediateRestart=false, RteEventRef=InitEvent, RteMappedToTaskRef=OsSonarTask, RteUsedOsEventRef=OsSonarEvent
      RearLedSWC: RteSoftwareComponentInstanceRef=RearLedSWC
        LEDActuator_timingEvent_0_1_OsLEDTask (RteEventToTaskMapping): RteImmediateRestart=false, RteEventRef=LEDActuator_timingEvent_0_1, RteMappedToTaskRef=OsLEDTask, RteUsedOsEventRef=OsLEDEvent
      ultrasonicSWC: RteSoftwareComponentInstanceRef=ultrasonicSWC
        UltraSonic_timingEvent_0_1_OsSonarTask (RteEventToTaskMapping): RteImmediateRestart=false, RteEventRef=UltraSonic_timingEvent_0_1, RteMappedToTaskRef=OsSonarTask, RteUsedOsEventRef=OsSonarEvent
  module config PduR: implementation-config-variant=VARIANT-PRE-COMPILE, module-description=PduR
    PduRGeneral: PduRDevErrorDetect=true, PduRVersionInfoApi=false, PduRZeroCostOperation=false
    PduRRoutingTables: PduRConfigurationId=0, ArcPduRMaxRouteCount=50
      PduRRoutingTable: PduRIsMinimumRouting=false
        PduRRoutingPathRx (PduRRoutingPath)
          PduRDestPdu: ArcOverridenDestModule=Com, PduRDestPduRef=PduRx
          PduRSrcPdu: PduRSourcePduHandleId=, ArcOverridenSrcModule=CanIf, PduRSrcPduRef=PduRx
        PduRRoutingPathTx (PduRRoutingPath)
          PduRDestPdu: ArcOverridenDestModule=CanIf, PduRDestPduRef=PduTx
          PduRSrcPdu: PduRSourcePduHandleId=, ArcOverridenSrcModule=Com, PduRSrcPduRef=PduTx
    CanIf (PduRBswModules):
      PduRCancelReceive = false
      PduRCancelTransmit = 
      PduRChangeParameterRequestApi = 
      PduRCommunicationInterface = 
      PduRLowerModule = 1
      PduRRetransmission = 
      PduRTransportProtocol = 
      PduRTriggertransmit = 
      PduRTxConfirmation = 
      PduRUpperModule = 0
      PduRUseTag = 
      PduRBswModuleRef = (unset)
    Com (PduRBswModules):
      PduRCancelReceive = false
      PduRCancelTransmit = 
      PduRChangeParameterRequestApi = 
      PduRCommunicationInterface = 
      PduRLowerModule = 0
      PduRRetransmission = 
      PduRTransportProtocol = 
      PduRTriggertransmit = 
      PduRTxConfirmation = 
      PduRUpperModule = 1
      PduRUseTag = 
      PduRBswModuleRef = (unset)
  module config EcuC: implementation-config-variant=VARIANT-PRE-COMPILE, module-description=EcuC
    EcucPduCollection: PduIdTypeEnum=UINT16, PduLengthTypeEnum=UINT16
      PduTx (Pdu): PduLength=32
      PduRx (Pdu): PduLength=32
  module config IoHwAb: implementation-config-variant=VARIANT-PRE-COMPILE, module-description=IoHwAb
    ArcIoHwAbGeneral: ArcIoHwAbDevErrorDetect=true, ArcIoHwAbAnalogMaxVoltage=5.0, ArcIoHwAbUsePort=false, ArcIoHwCalibrationEnabled=false
    4 x ArcIoHwAbDigitalSignal, all with ArcIoHwAbDigitalDefaultValue=IOHWAB_LOW, ArcIoHwAbDigitalInverted=false, ArcIoHwAbDigitalType=IOHWAB_DIO:
      DigitalFrontLED: ArcIoHwAbDigitalMethod=IOHWAB_DIGITAL_WRITE, ArcIoHwAbDioChannelRef=LED/FrontLED
      DigitalRearLED: ArcIoHwAbDigitalMethod=IOHWAB_DIGITAL_WRITE, ArcIoHwAbDioChannelRef=LED/RearLED
      DigitalSonarEcho: ArcIoHwAbDigitalMethod=IOHWAB_DIGITAL_READ, ArcIoHwAbDioChannelRef=SonarEcho
      DigitalSonarTrig: ArcIoHwAbDigitalMethod=IOHWAB_DIGITAL_WRITE, ArcIoHwAbDioChannelRef=SonarTrig
  module config Os: implementation-config-variant=VARIANT-PRE-COMPILE, module-description=Os
    OsAppMode
    OsOS:
      OsScalabilityClass = SC1
      OsStackMonitoring = true
      OsStatus = EXTENDED
      OsUseGetServiceId = true
      OsUseParameterAccess = true
      OsUseResScheduler = true
      ArcOsTickFrequency = 1000
      ArcOsInterruptStackSize = 2048
      ArcOsIdleStackSize = 512
      ArcOsMaxIsr = 10
      OsHooks: OsErrorHook=false, OsPostTaskHook=false, OsPreTaskHook=false, OsShutdownHook=false, OsStartupHook=false
      ArcOsDebug: OsTaskDebug=false, OsAlarmDebug=false, OsResourceDebug=false, OsScheduleTableDebug=false, OsEventDebug=false, OsDebugActivated=false
    OsAlarmBswService (OsAlarm): OsAlarmCounterRef=OsCounter
      OsAlarmAction
        OsAlarmActivateTask: OsAlarmActivateTaskRef=OsBswServiceTask
      OsAlarmAutostart: OsAlarmAlarmTime=5, OsAlarmAutostartType=RELATIVE, OsAlarmCycleTime=5, OsAlarmAppModeRef=(unset)
    OsBswServiceTask (OsTask): OsTaskActivation=1, OsTaskPriority=5, OsTaskSchedule=FULL, ArcOsTaskStackSize=2048
      OsTaskAutostart: OsTaskAppModeRef=(unset)
    OsSonarTask (OsTask): OsTaskActivation=1, OsTaskPriority=2, OsTaskSchedule=FULL, ArcOsTaskStackSize=2048, OsTaskEventRef=OsSonarEvent
      OsTaskAutostart: OsTaskAppModeRef=(unset)
    OsSonarEvent (OsEvent)
    OsCounter: OsCounterMaxAllowedValue=65535, OsCounterMinCycle=1, OsCounterTicksPerBase=, OsCounterType=OS_TICK
    OsAlarmSonar (OsAlarm): OsAlarmCounterRef=OsCounter
      OsAlarmAction
        OsAlarmSetEvent: OsAlarmSetEventRef=OsSonarEvent, OsAlarmSetEventTaskRef=OsSonarTask
      OsAlarmAutostart: OsAlarmAlarmTime=40, OsAlarmAutostartType=RELATIVE, OsAlarmCycleTime=40, OsAlarmAppModeRef=(unset)
    OsAlarmCollisionDetection (OsAlarm): OsAlarmCounterRef=OsCounter
      OsAlarmAction
        OsAlarmSetEvent: OsAlarmSetEventRef=OsCollisionDetectionEvent, OsAlarmSetEventTaskRef=OsCollisionDetectionTask
      OsAlarmAutostart: OsAlarmAlarmTime=20, OsAlarmAutostartType=RELATIVE, OsAlarmCycleTime=20, OsAlarmAppModeRef=(unset)
    3 x OsTask, all with OsTaskActivation=1, OsTaskSchedule=FULL, ArcOsTaskStackSize=2048:
      OsCollisionDetectionTask: OsTaskPriority=3, OsTaskEventRef=OsCollisionDetectionEvent
        OsTaskAutostart: OsTaskAppModeRef=(unset)
      OsLEDTask: OsTaskPriority=4, OsTaskEventRef=OsLEDEvent
        OsTaskAutostart: OsTaskAppModeRef=(unset)
      OsStartupTask: OsTaskPriority=1
        OsTaskAutostart: OsTaskAppModeRef=(unset)
    OsCollisionDetectionEvent (OsEvent)
    OsLEDEvent (OsEvent)
    OsAlarmLED (OsAlarm): OsAlarmCounterRef=OsCounter
      OsAlarmAction
        OsAlarmSetEvent: OsAlarmSetEventRef=OsLEDEvent, OsAlarmSetEventTaskRef=OsLEDTask
      OsAlarmAutostart: OsAlarmAlarmTime=10, OsAlarmAutostartType=RELATIVE, OsAlarmCycleTime=10, OsAlarmAppModeRef=(unset)
    OsApplication:
      OsTrusted = true
      OsAppAlarmRef = OsAlarmBswService
      OsAppCounterRef = OsCounter
      OsAppAlarmRef = OsAlarmCollisionDetection
      OsAppAlarmRef = OsAlarmLED
      OsAppAlarmRef = OsAlarmSonar
      OsAppTaskRef = OsBswServiceTask
      OsAppTaskRef = OsCollisionDetectionTask
      OsAppTaskRef = OsLEDTask
      OsAppTaskRef = OsSonarTask
      OsAppTaskRef = OsStartupTask
      OsApplicationHooks: OsAppErrorHook=false, OsAppShutdownHook=false, OsAppStartupHook=false
  module config Det: implementation-config-variant=VARIANT-PRE-COMPILE, module-description=Det
    DetGeneral:
      DetVersionInfoApi = false
      DetUseRamlog = true
      DetEnableCallbacks = false
      DetWrapRamlog = true
      DetUseStdErr = false
      DetDeInitAPI = false
      DetNumberOfCallbacks = 5
      DetRamlogSize = 16
      DetUseSafetyMonitor = false
