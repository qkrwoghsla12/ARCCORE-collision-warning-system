AUTOSAR XML (schema 4-3-0)
package /CollisionDetectionApplicationLayer/EcuExtract
  system CollisionDetectionEcuExtract: category=ECU_EXTRACT, system-version=1
    system mapping ImplementationMappings
      sw-impl-mappings:
        10 x swc to impl mapping:
          EcuMMap: component-implementation=EcuMFixedImpl, component=RootSwComposition.ecuM
          SwcToImplMapping_for_BswMComponentImpl_to_bswM: component-implementation=BswMComponentImpl, component=RootSwComposition.bswM
          SwcToImplMapping_for_ComMImpl_to_comM: component-implementation=ComMImpl, component=RootSwComposition.comM
          IoHwAbMap: component-implementation=IoHwAbImpl, component=RootSwComposition.ioHwAb
          SwcToImplMapping_for_UltraSonicSWCImpl_to_ultrasonicSWC: component-implementation=UltraSonicSWCImpl, component=RootSwComposition.ultrasonicSWC
          SwcToImplMapping_for_CanTranslateSWCImpl_to_cantranslateSWC: component-implementation=CanTranslateSWCImpl, component=RootSwComposition.cantranslateSWC
          SwcToImplMapping_for_CollisionDetectionSWCImpl_to_collisiondetectionSWC: component-implementation=CollisionDetectionSWCImpl, component=RootSwComposition.collisiondetectionSWC
          SwcToImplMapping_for_LEDActuatorSWCImpl_to_RearLedSWC: component-implementation=LEDActuatorSWCImpl, component=RootSwComposition.RearLedSWC
          SwcToImplMapping_for_LEDActuatorSWCImpl_to_FrontLedSWC: component-implementation=LEDActuatorSWCImpl, component=RootSwComposition.FrontLedSWC
          SwcToImplMapping_for_ModeManagerSWCImpl_to_modeManagerInitSWC: component-implementation=ModeManagerSWCImpl, component=RootSwComposition.modeManagerInitSWC
    system mapping SignalMappings
      data-mappings:
        data-element=RootSwComposition.CanTxPortOut.message, system-signal=TxMessageSystemSignal
        data-element=RootSwComposition.CanRxPortOut.message, system-signal=RxMessageSystemSignal
    root-software-compositions:
      root sw composition prototype RootSwComposition: software-composition=RootComposition
