AUTOSAR XML (schema 4-3-0)
package /CollisionDetectionApplicationLayer/Signals
  pdu RxMessageiSignalPdu: unused-bit-pattern=0
    signal RxMessageiSignal: 0 bit, system signal RxMessageSystemSignal, data-type-policy=NETWORK-REPRESENTATION-FROM-COM-SPEC
  pdu TxMessageiSignalPdu: unused-bit-pattern=0
    signal TxMessageiSignal: 0 bit, system signal TxMessageSystemSignal, data-type-policy=NETWORK-REPRESENTATION-FROM-COM-SPEC
