AUTOSAR XML (schema 4-3-0)
package /CollisionDetectionApplicationLayer/Interface
  impl type IntImpl: category=VALUE, base-type=uint32
  app type Int: category=VALUE, base-type=uint32
  impl type LedStatusImpl: category=BOOLEAN, base-type=boolean
  app type LedStatus: category=BOOLEAN, base-type=boolean
  sender receiver interface DataInterface
    data message: type=Int
  sender receiver interface SonarDataInterface
    data distance: type=Int
  sender receiver interface LedRequestInterface
    data Status: type=LedStatus
  data type mapping set TypeMappings
    data-type-maps:
      application-data-type=Int, implementation-data-type=IntImpl
      application-data-type=LedStatus, implementation-data-type=LedStatusImpl
